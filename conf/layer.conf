## conf/layer.conf
```bitbake
# We have a conf and classes directory, add to BBPATH
BBPATH .= ":${LAYERDIR}"

# We have recipes-* directories, add to BBFILES
BBFILES += "${LAYERDIR}/recipes-*/*/*.bb \
${LAYERDIR}/recipes-*/*/*.bbappend"

BBFILE_COLLECTIONS += "sitec-s7"
BBFILE_PATTERN_sitec-s7 = "^${LAYERDIR}/"
BBFILE_PRIORITY_sitec-s7 = "10"
LAYERVERSION_sitec-s7 = "1"
```

## conf/machine/s7.conf
```bitbake
#@TYPE: Machine
#@NAME: S7
#@DESCRIPTION: sitec systems S7 Telematic Module

require conf/machine/include/phyam335x.inc

SOC_FAMILY .= ":phycore-am335x"

# Kernel
KERNEL_DEVICETREE = "am335x-s7.dtb"
KERNEL_IMAGETYPE = "zImage"
UBOOT_LOADADDRESS = "0x80008000"
UBOOT_LOADADDRESS = "80008000"

# Barebox
BAREBOX_BIN = "images/barebox-am33xx-phytec-phycore.img"
BAREBOX_IPL_BIN = "images/barebox-am33xx-phytec-phycore-mlo-512mb.img"
```
